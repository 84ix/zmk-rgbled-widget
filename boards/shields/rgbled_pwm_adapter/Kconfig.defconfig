## boards/shields/rgbled_pwm_adapter/Kconfig.defconfig
```kconfig
if SHIELD_RGBLED_PWM_ADAPTER

config RGBLED_WIDGET
    default y

config RGBLED_WIDGET_BACKEND_PWM
    default y

config RGBLED_WIDGET_RAINBOW
    default y

endif # SHIELD_RGBLED_PWM_ADAPTER
```

## boards/shields/rgbled_pwm_adapter/Kconfig.shield
```kconfig
config SHIELD_RGBLED_PWM_ADAPTER
    def_bool $(shields_list_contains,rgbled_pwm_adapter)
```

## dts/bindings/behaviors/zmk,behavior-rgbled-rainbow.yaml
```yaml
description: RGB LED rainbow indicator behavior

compatible: "zmk,behavior-rgbled-rainbow"

include: zero_param.yaml
```
